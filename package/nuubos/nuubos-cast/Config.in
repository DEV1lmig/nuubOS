## package/nuubos/nuubos-cast/Config.in
```kconfig
config BR2_PACKAGE_NUUBOS_CAST
	bool "nuubOS screen casting service"
	depends on BR2_TOOLCHAIN_HAS_THREADS_NPTL # libvpx
	depends on BR2_INSTALL_LIBSTDCPP # libvpx VP8 encoder
	depends on BR2_PACKAGE_WAYLAND
	depends on BR2_PACKAGE_PIPEWIRE
	depends on BR2_PACKAGE_FFMPEG_SWSCALE
	select BR2_PACKAGE_NUUBOS_NOTIFY
	select BR2_PACKAGE_CJSON
	select BR2_PACKAGE_LIBCURL # OpenH264 download
	select BR2_PACKAGE_OPENSSL # Cast TLS, AES, digests
	select BR2_PACKAGE_LIBVPX # VP8 (Google Cast)
	select BR2_PACKAGE_OPUS # Opus (Google Cast)
	help
	  Screen casting (EPIC-029): the console's screen and sound on a
	  TV or computer over the network. Google Cast (Cast Streaming
	  mirroring, Default Media Receiver fallback), Miracast over
	  Infrastructure (MS-MICE, with Cisco's OpenH264 downloaded on
	  request) and DLNA renderers. Needs FFmpeg with the mpeg2video,
	  mp2 and aac encoders and the mpegts, adts and webm muxers.
```

## package/nuubos/nuubos-files/Config.in
```kconfig
config BR2_PACKAGE_NUUBOS_FILES
	bool "nuubos-files"
	depends on BR2_USE_MMU
	select BR2_PACKAGE_NUUBOS_JOBS
	select BR2_PACKAGE_LIBSMB2
	help
	  EPIC-031/032/035/036 and USB storage (EPIC-024): File Manager
	  operations (nuubos-filesctl), removable media mount/eject
	  (nuubos-mediactl) and SMB network shares (nuubos-sharesctl),
	  long operations as nuubos-jobd jobs. The console backup
	  (EPIC-035) is nuubos-sd2-backup in the rootfs overlay.
```

## package/nuubos/nuubos-fonts-noto/Config.in
```kconfig
config BR2_PACKAGE_NUUBOS_FONTS_NOTO
	bool "nuubOS Noto fonts (CJK, Thai, Devanagari)"
	help
	  Glyph fallback for the interface languages Cantarell does not
	  cover: Noto Sans CJK (Japanese, Chinese, Korean; Regular and
	  Bold OpenType collections), Noto Sans Thai and Noto Sans
	  Devanagari. SIL Open Font License 1.1.

	  https://github.com/notofonts
```

## package/nuubos/nuubos-ports/Config.in
```kconfig
config BR2_PACKAGE_NUUBOS_PORTS
	bool "nuubOS ports service (PortMaster)"
	depends on BR2_PACKAGE_WAYLAND # sdl2 wayland
	depends on BR2_PACKAGE_HAS_LIBEGL # sdl2 wayland
	depends on BR2_PACKAGE_HAS_LIBGLES # sdl2 opengles
	depends on BR2_USE_WCHAR # python3
	depends on BR2_TOOLCHAIN_HAS_THREADS # python3, bubblewrap
	depends on BR2_USE_MMU # python3, bubblewrap
	depends on !BR2_STATIC_LIBS # python3
	depends on BR2_INSTALL_LIBSTDCPP # openal
	depends on BR2_TOOLCHAIN_GCC_AT_LEAST_7 # openal
	depends on BR2_TOOLCHAIN_HAS_THREADS_NPTL # openal
	depends on BR2_PACKAGE_OPENAL_ARCH_SUPPORTS # openal
	select BR2_PACKAGE_BASH # port scripts
	select BR2_PACKAGE_BUBBLEWRAP # sandbox
	select BR2_PACKAGE_PYTHON3 # PortMaster GUI (pugwash)
	select BR2_PACKAGE_PYTHON3_SSL # downloads
	select BR2_PACKAGE_PYTHON3_ZLIB # zip files
	select BR2_PACKAGE_PYTHON3_XZ # tar.xz files
	select BR2_PACKAGE_PYTHON3_BZIP2 # tar.bz2 files
	select BR2_PACKAGE_PYTHON3_PYEXPAT # gamelist XML
	select BR2_PACKAGE_PYTHON3_UNICODEDATA
	select BR2_PACKAGE_SDL2
	select BR2_PACKAGE_SDL2_WAYLAND
	select BR2_PACKAGE_SDL2_OPENGLES
	select BR2_PACKAGE_SDL2_IMAGE
	select BR2_PACKAGE_LIBPNG # sdl2_image png
	select BR2_PACKAGE_JPEG # sdl2_image jpg
	select BR2_PACKAGE_SDL2_TTF
	select BR2_PACKAGE_SDL2_MIXER
	select BR2_PACKAGE_SDL2_GFX
	select BR2_PACKAGE_OPENAL # LOVE runtime, many ports
	select BR2_PACKAGE_LIBVORBIS # LOVE runtime, many ports
	select BR2_PACKAGE_LIBTHEORA # LOVE runtime (liblove needs libtheoradec)
	select BR2_PACKAGE_LIBCURL # PortMaster download
	select BR2_PACKAGE_OPENSSL # PortMaster checksum
	select BR2_PACKAGE_CA_CERTIFICATES # downloads (TLS)
	help
	  Ports (EPIC-058): PortMaster, downloaded on the device and
	  updated by itself, and the ports it installs, each run in a
	  sandbox (bubblewrap) that only sees its own folder. The image
	  holds what PortMaster and the ports expect from the system:
	  bash, Python 3, SDL2 and its image/ttf/mixer/gfx libraries,
	  OpenAL, Vorbis and Theora.
```

## package/nuubos/nuubos-remote/Config.in
```kconfig
config BR2_PACKAGE_NUUBOS_REMOTE
	bool "nuubos-remote"
	depends on BR2_USE_MMU
	depends on BR2_PACKAGE_HOST_RUSTC_TARGET_ARCH_SUPPORTS
	select BR2_PACKAGE_HOST_RUSTC
	select BR2_PACKAGE_DROPBEAR
	select BR2_PACKAGE_KSMBD_TOOLS
	select BR2_PACKAGE_LIGHTTPD
	select BR2_PACKAGE_LIGHTTPD_OPENSSL
	select BR2_PACKAGE_OPENSSL
	select BR2_PACKAGE_CANTARELL
	select BR2_PACKAGE_NUUBOS_LIBRARY
	help
	  EPIC-037/038/039: Remote Services, each disabled by default and
	  switched in Settings: SSH/SCP/SFTP (Dropbear, root + device password),
	  SMB file sharing (kernel ksmbd) and the Web administration (HTTPS,
	  lighttpd + nuubos-admind, sign-in page with the device credential),
	  all with one random per-device credential kept in STATE.
```

## package/nuubos/nuubos-sync/Config.in
```kconfig
config BR2_PACKAGE_NUUBOS_SYNC
	bool "nuubos-sync"
	depends on BR2_USE_MMU
	depends on BR2_PACKAGE_HOST_GO_TARGET_ARCH_SUPPORTS
	select BR2_PACKAGE_SYNCTHING
	select BR2_PACKAGE_CJSON
	select BR2_PACKAGE_LIBCURL
	select BR2_PACKAGE_NUUBOS_NOTIFY
	help
	  EPIC-034: optional per-user Syncthing (saves, save states,
	  screenshots) run for the active user only by nuubos-syncd, the
	  owner of the sync state (socket /run/nuubos/syncd.sock);
	  nuubos-syncctl is its command line.
```

## package/nuubos/nuubos-tailscale/Config.in
```kconfig
config BR2_PACKAGE_NUUBOS_TAILSCALE
	bool "nuubos-tailscale"
	depends on BR2_USE_MMU
	select BR2_PACKAGE_CJSON
	select BR2_PACKAGE_LIBCURL
	select BR2_PACKAGE_OPENSSL
	select BR2_PACKAGE_ZLIB
	help
	  Tailscale for the console: nuubos-tsd downloads Tailscale's
	  daemon on request (never part of the image), runs it while the
	  user keeps it on and publishes its state (socket
	  /run/nuubos/tsd.sock); nuubos-tsctl is its command line.
```

## package/nuubos/nuubos-terminal/Config.in
```kconfig
config BR2_PACKAGE_NUUBOS_TERMINAL
	bool "nuubos-terminal"
	depends on BR2_TOOLCHAIN_USES_GLIBC || BR2_TOOLCHAIN_USES_MUSL # foot
	depends on !BR2_STATIC_LIBS # foot
	select BR2_PACKAGE_FOOT
	help
	  Terminal application (RC4, user decision 2026-10-27): root's
	  login shell, the same environment as an SSH login, in foot
	  under labwc. nuubos-termd owns the session; nuubos-inputd turns
	  the controller into terminal keys and the Quick Menu provides
	  the on-screen keyboard through the Wayland input method.
	  Needs a UTF-8 locale (BR2_GENERATE_LOCALE C.UTF-8).
```

## package/nuubos/nuubos-update/Config.in
```kconfig
config BR2_PACKAGE_NUUBOS_UPDATE
	bool "nuubos-update"
	depends on BR2_USE_MMU
	select BR2_PACKAGE_NUUBOS_JOBS
	select BR2_PACKAGE_LIBCURL
	select BR2_PACKAGE_CA_CERTIFICATES
	select BR2_PACKAGE_LIBSODIUM
	select BR2_PACKAGE_ZLIB
	help
	  EPIC-048 OTA updates: signed release manifest (Ed25519, public
	  key from board/nuubos/common/ota/update-key.pub) per release
	  channel on GitHub Releases, resumable verified download,
	  installation into the inactive A/B system slot and automatic
	  return to the previous slot (U-Boot trial boots) when the new
	  system does not reach nuubUI.
```

## package/thirdparty/libsmb2/Config.in
```kconfig
config BR2_PACKAGE_LIBSMB2
	bool "libsmb2"
	help
	  Client library for SMB2/SMB3 (Ronnie Sahlberg). nuubOS uses it
	  to list the shared folders of a server (srvsvc
	  NetShareEnumAll) when adding a network location (EPIC-036);
	  mounting stays the kernel CIFS client.

	  https://github.com/sahlberg/libsmb2
```
